## configs/itop4412_defconfig
```kconfig
# arch
CONFIG_ARM=y
CONFIG_ARCH_EXYNOS=y
CONFIG_ARCH_EXYNOS4=y
CONFIG_TARGET_ITOP4412=y

# config
CONFIG_ARCH_CPU_INIT=y
CONFIG_NR_DRAM_BANKS=8
# CONFIG_SYS_DCACHE_OFF is not set

# spl
CONFIG_SPL=y
CONFIG_SPL_SKIP_LOWLEVEL_INIT=y
CONFIG_SPL_TEXT_BASE=0x02023400
CONFIG_SPL_FOOTPRINT_LIMIT=y
CONFIG_SPL_MAX_FOOTPRINT=0x3800
# CONFIG_SPL_FRAMEWORK is not set

# bl2
CONFIG_TEXT_BASE=0x43E00000
CONFIG_SYS_LOAD_ADDR=0x43E00000
CONFIG_SYS_MALLOC_F_LEN=0x400
CONFIG_BOARD_LATE_INIT=y
CONFIG_SKIP_LOWLEVEL_INIT_ONLY=y
CONFIG_SUPPORT_EMMC_BOOT=y
CONFIG_HAS_CUSTOM_SYS_INIT_SP_ADDR=y
CONFIG_CUSTOM_SYS_INIT_SP_ADDR=0x43DFFF00

# env
CONFIG_ENV_SIZE=0x4000
CONFIG_ENV_OFFSET=0x86200

# dtb
CONFIG_OF_CONTROL=y
CONFIG_DEFAULT_DEVICE_TREE="exynos4412-itop"

# hw
CONFIG_NET=y
CONFIG_USB=y
CONFIG_USB_EHCI_HCD=y
CONFIG_USB_HOST_ETHER=y
CONFIG_MTD_UBI=y
CONFIG_BITREVERSE=y
CONFIG_MMC_DW=y
CONFIG_MMC_SDHCI=y
CONFIG_MMC_SDHCI_S5P=y

# fs
CONFIG_FS_EXT4=y
CONFIG_PARTITIONS=y
CONFIG_DOS_PARTITION=y
CONFIG_CMD_FS_GENERIC=y
# CONFIG_FS_FAT is not set

# cmd
CONFIG_CMD_MMC=y
CONFIG_CMD_USB=y
CONFIG_CMD_BOOTZ=y
CONFIG_HUSH_PARSER=y
CONFIG_IDENT_STRING=" for itop-4412"
# CONFIG_CMD_DM is not set
# CONFIG_CMD_FAT is not set
# CONFIG_CMD_FDT is not set
# CONFIG_CMD_ITEST is not set
# CONFIG_CMD_CONSOLE is not set
# CONFIG_CMD_MEMORY is not set
# CONFIG_CMD_EXT2 is not set
# CONFIG_CMD_EXT4 is not set
# CONFIG_CMD_SF is not set
# CONFIG_CMD_XIMG is not set
# CONFIG_CMD_ELF is not set
# CONFIG_BOOTSTD is not set
# CONFIG_MTD is not set
# CONFIG_SPI_FLASH is not set
# CONFIG_CMD_SETEXPR is not set
# CONFIG_CMD_LOADB is not set
# CONFIG_CMD_BOOTP is not set
# CONFIG_CMD_CRC32 is not set
# CONFIG_CMD_SLEEP is not set
# CONFIG_CMD_LOADS is not set
# CONFIG_BOOT_DEFAULTS is not set
# CONFIG_CMD_BLOCK_CACHE is not set
# CONFIG_DISTRO_DEFAULTS is not set
# CONFIG_USE_BOOTCOMMAND is not set

# efi
# CONFIG_EFI_LOADER is not set
```
